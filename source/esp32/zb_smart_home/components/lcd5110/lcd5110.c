#include "lcd5110.h"

#include <driver/gpio.h>
#include <driver/spi_master.h>
#include <esp_log.h>
#include <freertos/FreeRTOS.h>
#include <freertos/task.h>
#include <stdint.h>
#include <stdio.h>
#include <string.h>

static spi_device_handle_t lcd_spi;

static int _dc_io_num;

static uint8_t LCD5110_Buffer[LCD5110_BUFFER_SIZE];
static uint8_t LCD5110_UpdateXmin = 0;
static uint8_t LCD5110_UpdateXmax = 0;
static uint8_t LCD5110_UpdateYmin = 0;
static uint8_t LCD5110_UpdateYmax = 0;
static uint8_t LCD5110_x;
static uint8_t LCD5110_y;

// Fonts 5x7
DRAM_ATTR static const uint8_t LCD5110_Font5x7[97][LCD5110_CHAR5x7_WIDTH] = {
    {0x00, 0x00, 0x00, 0x00, 0x00},  // sp
    {0x00, 0x00, 0x2f, 0x00, 0x00},  // !
    {0x00, 0x07, 0x00, 0x07, 0x00},  // "
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    {0x00, 0x7F, 0x3E, 0x1C, 0x08}   // Play			128
};

DRAM_ATTR static const uint8_t LCD5110_Font3x5[106][3] = {
    {0x00, 0x00, 0x00},  // sp - 32
    {0x00, 0x17, 0x00},  // ! - 33
    {0x03, 0x00, 0x03},  // " - 34
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    {0x1F, 0x1F, 0x1F},  // delete
};

static void lcd5110_write(lcd5110_write_type_t dc, uint8_t data) {
    spi_transaction_t t;
    memset(&t, 0, sizeof(t));  // Zero out the transaction
    t.length    = 8;           // Command is 8 bits
    t.tx_buffer = &data;       // The data is the cmd itself
    t.user      = (void *)dc;  // D/C
    spi_device_polling_transmit(lcd_spi, &t);
}

static void lcd5110_update_area(uint8_t xMin, uint8_t yMin, uint8_t xMax,
                                uint8_t yMax) {
    if (xMin < LCD5110_UpdateXmin) LCD5110_UpdateXmin = xMin;
    if (xMax > LCD5110_UpdateXmax) LCD5110_UpdateXmax = xMax;
    if (yMin < LCD5110_UpdateYmin) LCD5110_UpdateYmin = yMin;
    if (yMax > LCD5110_UpdateYmax) LCD5110_UpdateYmax = yMax;
}

void lcd_spi_pre_trans_cb(spi_transaction_t *t) {
    int dc = (int)t->user;
    gpio_set_level(_dc_io_num, dc);
}

void lcd5110_init(lcd5110_config_t *lcd_config) {
    spi_bus_config_t buscfg = {
        .miso_io_num     = -1,
        .mosi_io_num     = lcd_config->din_io_num,
        .sclk_io_num     = lcd_config->clk_io_num,
        .quadwp_io_num   = -1,
        .quadhd_io_num   = -1,
        .max_transfer_sz = 2048,
    };

    spi_device_interface_config_t devcfg = {
        .clock_speed_hz = 1000000,                // Clock out at 1 MHz
        .mode           = 0,                      // SPI mode 0
        .spics_io_num   = lcd_config->ce_io_num,  // CS pin
        .queue_size     = 8,             // Queue 8 transactions at a time
        .pre_cb = lcd_spi_pre_trans_cb,  // Specify pre-transfer callback to
                                         // handle D/C line
    };

    spi_bus_initialize(SPI2_HOST, &buscfg, SPI_DMA_CH_AUTO);
    spi_bus_add_device(SPI2_HOST, &devcfg, &lcd_spi);

    _dc_io_num = lcd_config->dc_io_num;
    gpio_set_direction(lcd_config->dc_io_num, GPIO_MODE_OUTPUT);
    gpio_set_direction(lcd_config->rst_io_num, GPIO_MODE_OUTPUT);

    // Reset
    gpio_set_level(lcd_config->rst_io_num, 0);
    vTaskDelay(10 / portTICK_PERIOD_MS);
    gpio_set_level(lcd_config->rst_io_num, 1);
    vTaskDelay(10 / portTICK_PERIOD_MS);

    // Go in extended mode
    lcd5110_write(LCD5110_COMMAND,
                  LCD5110_FUNCTIONSET | LCD5110_EXTENDEDINSTRUCTION);

    // LCD bias select
    lcd5110_write(LCD5110_COMMAND, LCD5110_SETBIAS | 0x4);

    // set VOP
    if (lcd_config->contrast > 0x7F) lcd_config->contrast = 0x7F;

    lcd5110_write(LCD5110_COMMAND, LCD5110_SETVOP | lcd_config->contrast);

    // normal mode
    lcd5110_write(LCD5110_COMMAND, LCD5110_FUNCTIONSET);

    // Set display to Normal
    lcd5110_write(LCD5110_COMMAND,
                  LCD5110_DISPLAYCONTROL | LCD5110_DISPLAYNORMAL);

    // Set cursor to home position
    lcd5110_home();

    // Normal display
    lcd5110_write(LCD5110_COMMAND,
                  LCD5110_DISPLAYCONTROL | LCD5110_DISPLAYNORMAL);

    // Clear display
    lcd5110_clear();
}

void lcd5110_clear(void) {
    unsigned int i;
    lcd5110_home();
    for (i = 0; i < LCD5110_BUFFER_SIZE; i++) LCD5110_Buffer[i] = 0x00;

    lcd5110_goto_xy(0, 0);
    lcd5110_update_area(0, 0, LCD5110_WIDTH - 1, LCD5110_HEIGHT - 1);
    lcd5110_refresh();
}

void lcd5110_home(void) {
    lcd5110_write(LCD5110_COMMAND, LCD5110_SETXADDR | 0);
    lcd5110_write(LCD5110_COMMAND, LCD5110_SETYADDR | 0);
}

void lcd5110_refresh(void) {
    uint8_t i, j;
    for (i = 0; i < 6; i++) {
        // Not in range yet
        if (LCD5110_UpdateYmin > ((i + 1) * 8)) continue;

        // Over range, stop
        if ((i * 8) > LCD5110_UpdateYmax) break;

        lcd5110_write(LCD5110_COMMAND, LCD5110_SETYADDR | i);
        lcd5110_write(LCD5110_COMMAND, LCD5110_SETXADDR | LCD5110_UpdateXmin);

        for (j = LCD5110_UpdateXmin; j <= LCD5110_UpdateXmax; j++)
            lcd5110_write(LCD5110_DATA,
                          LCD5110_Buffer[(i * LCD5110_WIDTH) + j]);
    }

    LCD5110_UpdateXmin = LCD5110_WIDTH - 1;
    LCD5110_UpdateXmax = 0;
    LCD5110_UpdateYmin = LCD5110_HEIGHT - 1;
    LCD5110_UpdateYmax = 0;
}

void lcd5110_goto_xy(uint8_t x, uint8_t y) {
    LCD5110_x = x;
    LCD5110_y = y;
}

static void lcd5110_draw_pixel(uint8_t x, uint8_t y, lcd5110_pixel_t pixel) {
    if (x >= LCD5110_WIDTH) return;
    if (y >= LCD5110_HEIGHT) return;

    if (pixel != LCD5110_PIXEL_CLEAR)
        LCD5110_Buffer[x + (y / 8) * LCD5110_WIDTH] |= 1 << (y % 8);
    else
        LCD5110_Buffer[x + (y / 8) * LCD5110_WIDTH] &= ~(1 << (y % 8));

    lcd5110_update_area(x, y, x, y);
}

void lcd5110_putc(lcd5110_pixel_t color, lcd5110_font_size_t size, char c) {
    uint8_t c_height = 0, c_width = 0, i = 0, b = 0, j = 0;
    if (size == LCD5110_FONT_SIZE_3x5) {
        c_width  = LCD5110_CHAR3x5_WIDTH;
        c_height = LCD5110_CHAR3x5_HEIGHT;
    } else {
        c_width  = LCD5110_CHAR5x7_WIDTH;
        c_height = LCD5110_CHAR5x7_HEIGHT;
    }
    if ((LCD5110_x + c_width) > LCD5110_WIDTH) {
        // If at the end of a line of display, go to new line and set x to 0
        // position
        LCD5110_y += c_height;
        LCD5110_x = 0;
    }
    for (i = 0; i < c_width - 1; i++) {
        if (c < 32) {
            // b = _custom_chars[_font_size][(uint8_t)chr][i];
        } else if (size == LCD5110_FONT_SIZE_3x5)
            b = LCD5110_Font3x5[c - 32][i];
        else
            b = LCD5110_Font5x7[c - 32][i];

        if (b == 0x00 && (c != 0 && c != 32 && c != 49)) continue;

        for (j = 0; j < c_height; j++) {
            if (color == LCD5110_PIXEL_SET)
                lcd5110_draw_pixel(
                    LCD5110_x, (LCD5110_y + j),
                    ((b >> j) & 1) ? LCD5110_PIXEL_SET : LCD5110_PIXEL_CLEAR);
            else
                lcd5110_draw_pixel(
                    LCD5110_x, (LCD5110_y + j),
                    ((b >> j) & 1) ? LCD5110_PIXEL_CLEAR : LCD5110_PIXEL_SET);
        }
        LCD5110_x++;
    }
    LCD5110_x++;
}

void lcd5110_puts(lcd5110_pixel_t color, lcd5110_font_size_t size,
                  const char *format, ...) {
    va_list arg;
    va_start(arg, format);
#ifndef USE_PRINTF_INSTEAD_FOR_PUTS
    char temp_str[50];
    vsnprintf(temp_str, 50, format, arg);
    for (uint8_t i = 0; i < strlen(temp_str); i++)
        lcd5110_putc(color, size, temp_str[i]);
#else
    printf("lcd5110: ");
    vprintf(format, arg);
    printf("\n");
#endif
    va_end(arg);
}

// HCMUT Logo for LCD5110 size 84x48
DRAM_ATTR static const uint8_t HCMUT_official_logo[] = {
    0x00, 0x00, 0x00, 0x00, 0x00, 0x00, 0x00, 0x00, 0x00, 0x00, 0x00, 0x00,
    0x00, 0x00, 0x00, 0x00, 0x00, 0x00, 0x00, 0x00, 0x00, 0x00, 0x00, 0x00,
    0x00, 0x00, 0x00, 0x80, 0x80, 0xC0, 0xC0, 0xE0, 0xE0, 0xF0, 0xF0, 0xF8,
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    0x00, 0x00, 0x00, 0x00, 0x00, 0x00, 0x00, 0x00, 0x00, 0x00, 0x00, 0x00,
};

void lcd5110_display_BK_logo(bool inverted) {
    lcd5110_clear();
    for (uint16_t i = 0; i < sizeof(HCMUT_official_logo); i++) {
        for (uint8_t j = 0; j < 8; j++)
            lcd5110_draw_pixel(
                i % LCD5110_WIDTH, j + (i / LCD5110_WIDTH) * 8,
                (((HCMUT_official_logo[i] & (1 << j)) != 0) ^ inverted)
                    ? LCD5110_PIXEL_SET
                    : LCD5110_PIXEL_CLEAR);
    }
    lcd5110_refresh();
}
